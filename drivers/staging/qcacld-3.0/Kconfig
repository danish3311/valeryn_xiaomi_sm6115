## drivers/staging/qcacld-3.0/Kconfig
```kconfig
comment "Qualcomm Atheros CLD WLAN module"

config QCA_CLD_WLAN
	tristate "Qualcomm Atheros CLD WLAN module"
	default n
	help
	  Add support for the Qualcomm Atheros CLD WLAN module

if QCA_CLD_WLAN != n

config QCA_CLD_WLAN_PROFILE
	string "Configuration profile for Qualcomm Atheros CLD WLAN module"
	default "default"
	help
	  Specify which configuration profile to be used for building
	  this module.

	  Profiles are located at drivers/staging/qcacld-3.0/configs.

config FEATURE_FRAME_INJECTION_TEST
	bool "Build qcacld-3.0 frame injection unit/integration tests"
	depends on QCA_CLD_WLAN
	default n
	help
	  Compile the FRAME_INJECTION *_test.c / *_comprehensive_test.c /
	  *_security_test.c / integration helpers into the WLAN driver.
	  Disabled by default; production NetHunter builds should leave
	  this off. Enable only for on-target driver self-tests.

endif # QCA_CLD_WLAN
```
